## ztest/testcase.yaml
```yaml
tests:
  littlefs.test.bd:
    platform_allow:
      - native_sim
      - mps2/an385
    integration_platforms:
      - mps2/an385
    tags:
      - filesystem
      - flash
    timeout: 120
```
